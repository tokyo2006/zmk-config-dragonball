## config/boards/shields/dragonball/Kconfig.shield
```kconfig
# Copyright (c) 2020 The ZMK Contributors
# SPDX-License-Identifier: MIT

config SHIELD_DRAGONBALL_CENTRAL_DONGLE
    def_bool $(shields_list_contains,dragonball_central_dongle)

config SHIELD_DRAGONBALL_CENTRAL_LEFT
    def_bool $(shields_list_contains,dragonball_central_left)
    
config SHIELD_DRAGONBALL_PERIPHERAL_LEFT
    def_bool $(shields_list_contains,dragonball_peripheral_left)

config SHIELD_DRAGONBALL_PERIPHERAL_RIGHT
    def_bool $(shields_list_contains,dragonball_peripheral_right)
```
