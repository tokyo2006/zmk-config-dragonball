## config/boards/shields/dragonball/Kconfig.defconfig
```kconfig
if SHIELD_DRAGONBALL_CENTRAL_DONGLE

config ZMK_KEYBOARD_NAME
    default "Dragonball"

config ZMK_SPLIT_ROLE_CENTRAL
    default y

endif


if SHIELD_DRAGONBALL_CENTRAL_DONGLE || SHIELD_DRAGONBALL_PERIPHERAL_LEFT || SHIELD_DRAGONBALL_PERIPHERAL_RIGHT

config ZMK_SPLIT
    default y

endif
```
