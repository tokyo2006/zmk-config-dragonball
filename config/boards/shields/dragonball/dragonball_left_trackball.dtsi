/*
 * Copyright (c) 2020 Pete Johanson
 *
 * SPDX-License-Identifier: MIT
 */

// release gpio1 12 & 13 from xiao_ble-pinctrl.dtsi
// for &trackball { irq-gpios }
&uart0 {
	status = "disabled";
};
&spi1 {
	compatible = "nordic,nrf-spim";
	status = "disabled"; // <<< disabled in main .dtsi, okay in .overlay
	pd2: pd@0 {
		compatible = "pixart,pmw3610";
		status = "disabled";
		label = "TRACKBALL2";
		reg = <0>;
		spi-max-frequency = <4000000>;
	};
};


